//////////////////////////////////////////////////
// MOTOR 1
//////////////////////////////////////////////////

#define PWM1  PA3
#define DIR1  PA2

//////////////////////////////////////////////////
// MOTOR 2
//////////////////////////////////////////////////

#define PWM2  PA1
#define DIR2  PA0

//////////////////////////////////////////////////
// MOTOR 3
//////////////////////////////////////////////////

#define PWM3  PA10
#define DIR3  PA9

//////////////////////////////////////////////////
// MOTOR 4
//////////////////////////////////////////////////

#define PWM4  PA8
#define DIR4  PB15

//////////////////////////////////////////////////
// UART2
// PA3 = RX
// PA2 = TX
//////////////////////////////////////////////////

HardwareSerial Serial2(PB7, PB6);

//////////////////////////////////////////////////
// SETUP
//////////////////////////////////////////////////

void setup()
{
    //////////////////////////////////////////////////
    // DEBUG SERIAL
    //////////////////////////////////////////////////

    Serial.begin(115200);

    //////////////////////////////////////////////////
    // UART TO RASPBERRY PI
    //////////////////////////////////////////////////

    Serial2.begin(115200);

    //////////////////////////////////////////////////
    // MOTOR PINS
    //////////////////////////////////////////////////

    pinMode(PWM1, OUTPUT);
    pinMode(DIR1, OUTPUT);

    pinMode(PWM2, OUTPUT);
    pinMode(DIR2, OUTPUT);

    pinMode(PWM3, OUTPUT);
    pinMode(DIR3, OUTPUT);

    pinMode(PWM4, OUTPUT);
    pinMode(DIR4, OUTPUT);

    //////////////////////////////////////////////////
    // STOP ALL MOTORS
    //////////////////////////////////////////////////

    analogWrite(PWM1, 0);
    analogWrite(PWM2, 0);
    analogWrite(PWM3, 0);
    analogWrite(PWM4, 0);

    Serial.println("Motor Control Ready");
}

//////////////////////////////////////////////////
// LOOP
//////////////////////////////////////////////////

void loop()
{
    receiveTargets();
}

//////////////////////////////////////////////////
// RECEIVE UART DATA
//////////////////////////////////////////////////

void receiveTargets()
{
    static String data = "";

    while (Serial2.available())
    {
        char c = Serial2.read();

        //////////////////////////////////////////////////
        // MESSAGE COMPLETE
        //////////////////////////////////////////////////

        if (c == '\n')
        {
            int comma = data.indexOf(',');

            //////////////////////////////////////////////////
            // VALID MESSAGE
            //////////////////////////////////////////////////

            if (comma > 0)
            {
                int leftSpeed =
                    data.substring(0, comma).toInt();

                int rightSpeed =
                    data.substring(comma + 1).toInt();

                //////////////////////////////////////////////////
                // DEBUG
                //////////////////////////////////////////////////

                Serial.print("Left: ");
                Serial.print(leftSpeed);

                Serial.print(" Right: ");
                Serial.println(rightSpeed);

                //////////////////////////////////////////////////
                // LEFT SIDE MOTORS
                //////////////////////////////////////////////////

                driveMotor(
                    PWM2,
                    DIR2,
                    leftSpeed
                );

                driveMotor(
                    PWM3,
                    DIR3,
                    leftSpeed
                );

                //////////////////////////////////////////////////
                // RIGHT SIDE MOTORS
                //////////////////////////////////////////////////

                driveMotor(
                    PWM1,
                    DIR1,
                    rightSpeed
                );

                driveMotor(
                    PWM4,
                    DIR4,
                    rightSpeed
                );
            }

            //////////////////////////////////////////////////
            // CLEAR BUFFER
            //////////////////////////////////////////////////

            data = "";
        }

        //////////////////////////////////////////////////
        // BUILD MESSAGE
        //////////////////////////////////////////////////

        else
        {
            data += c;
        }
    }
}

//////////////////////////////////////////////////
// SIMPLE MOTOR DRIVER
//////////////////////////////////////////////////

void driveMotor(
    int pwmPin,
    int dirPin,
    int speedVal
)
{
    //////////////////////////////////////////////////
    // LIMIT PWM
    //////////////////////////////////////////////////

    int pwm = abs(speedVal);

    if (pwm > 255)
        pwm = 255;

    //////////////////////////////////////////////////
    // DIRECTION
    //////////////////////////////////////////////////

    if (speedVal >= 0)
        digitalWrite(dirPin, HIGH);
    else
        digitalWrite(dirPin, LOW);

    //////////////////////////////////////////////////
    // SPEED
    //////////////////////////////////////////////////

    analogWrite(pwmPin, pwm);
}
